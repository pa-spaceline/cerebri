## west.yml
```yaml
# Copyright (c) 2023 CogniPilot Foundation
# SPDX-License-Identifier: Apache-2.0

manifest:

  group-filter:
    - +optional

  self:
    west-commands: scripts/west-commands.yml

  remotes:
    - name: zephyrproject-rtos
      url-base: https://github.com/zephyrproject-rtos
    - name: cognipilot
      url-base: https://github.com/CogniPilot
    - name: pa-spaceline
      url-base: git@github.com:pa-spaceline

  projects:
    - name: zephyr
      remote: pa-spaceline
      west-commands: scripts/west-commands.yml
      revision: af7ea8830d61d32b6f44b9335ab3ea25d3aa0e53 # tropic-community-fixes 09/28/26
      import:
        - name-allowlist:
          - nanopb
          - mbedtls
          - hal_nxp
          - cmsis
          - cmsis-dsp
          - cmsis_6
          - fatfs
          - open-amp
          - libmetal
          - segger
    - name: zros
      remote: pa-spaceline
      revision: 003a2dc03adec493b83bd6fcff58f61b4e59924a # tropic-community-fixes 09/28/26
      path: modules/lib/zros
    - name: hal_tdk
      remote: pa-spaceline
      revision: 9fe7945ca534f82dfc6942f11fc8719069299708 # tropic-community-fixes 09/24/26
      path: modules/hal/tdk
      groups:
        - hal
    - name: cyecca
      remote: pa-spaceline
      revision: 3fc65f3e756d5262914e1b6047a38779b699cb17 # tropic-community-fixes 09/24/26
      path: modules/lib/cyecca
    - name: synapse_pb
      remote: cognipilot
      revision: f038dd178faac0481033e5e4c757e31777c1b0be # main 11/10/25
      path: modules/lib/synapse_pb
    - name: hal_nxp
      remote: cognipilot
      revision: cf8f1631e862528ee044850bcc70273975b90771 # master 10/27/25
      path: modules/hal/nxp
    - name: zros_drivers
      remote: pa-spaceline
      revision: 2f269603689ef2e98f2d8d91594297e01dc65d8a # tropic-community-fixes 09/28/26
      path: modules/lib/zros_drivers
    - name: zephyr_boards
      remote: pa-spaceline
      revision: 132d0a3be7ecb473e8bc26715a643d97d4d38459 # tropic-community-fixes 09/24/26
      path: modules/lib/zephyr_boards
```
